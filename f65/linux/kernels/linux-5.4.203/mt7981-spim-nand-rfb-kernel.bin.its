## f65/linux/kernels/linux-5.4.203/mt7981-spim-nand-rfb-kernel.bin.its
```
/dts-v1/;

/ {
	description = "ARM64 OpenWrt FIT (Flattened Image Tree)";
	#address-cells = <1>;

	images {
		kernel@1 {
			description = "ARM64 OpenWrt Linux-5.4.203";
			data = /incbin/("/home/dzq/share/eap2/PLATFORM/build/../linux/kernels/linux-5.4.203/mt7981-spim-nand-rfb-kernel.bin");
			type = "kernel";
			arch = "arm64";
			os = "linux";
			compression = "lzma";
			load = <0x48080000>;
			entry = <0x48080000>;
			hash@1 {
				algo = "crc32";
			};
			hash@2 {
				algo = "sha1";
			};
		};

		fdt@EAP650_3_0_0 {
			description = "ARM64 OpenWrt mt7981-spim-nand-rfb device tree blob";
			data = /incbin/("/home/dzq/share/eap2/PLATFORM/build/../linux/kernels/linux-5.4.203/arch/arm64/boot/dts/mediatek/mt7981-EAP650_3_0_0.dtb");
			type = "flat_dt";
			arch = "arm64";
			compression = "none";
			hash@1 {
				algo = "crc32";
			};
			hash@2 {
				algo = "sha1";
			};
		};

		fdt@EAP653_3_0_0 {
			description = "ARM64 OpenWrt mt7981-spim-nand-rfb device tree blob";
			data = /incbin/("/home/dzq/share/eap2/PLATFORM/build/../linux/kernels/linux-5.4.203/arch/arm64/boot/dts/mediatek/mt7981-EAP653_3_0_0.dtb");
			type = "flat_dt";
			arch = "arm64";
			compression = "none";
			hash@1 {
				algo = "crc32";
			};
			hash@2 {
				algo = "sha1";
			};
		};

		fdt@EAP655-WE_1_0_0 {
			description = "ARM64 OpenWrt mt7981-spim-nand-rfb device tree blob";
			data = /incbin/("/home/dzq/share/eap2/PLATFORM/build/../linux/kernels/linux-5.4.203/arch/arm64/boot/dts/mediatek/mt7981-EAP655-WE_1_0_0.dtb");
			type = "flat_dt";
			arch = "arm64";
			compression = "none";
			hash@1 {
				algo = "crc32";
			};
			hash@2 {
				algo = "sha1";
			};
		};

		fdt@EAP655-WE-AC_1_0_0 {
			description = "ARM64 OpenWrt mt7981-spim-nand-rfb device tree blob";
			data = /incbin/("/home/dzq/share/eap2/PLATFORM/build/../linux/kernels/linux-5.4.203/arch/arm64/boot/dts/mediatek/mt7981-EAP655-WE-AC_1_0_0.dtb");
			type = "flat_dt";
			arch = "arm64";
			compression = "none";
			hash@1 {
				algo = "crc32";
			};
			hash@2 {
				algo = "sha1";
			};
		};

		fdt@EAP650-Wall_2_0_0 {
			description = "ARM64 OpenWrt mt7981-spim-nand-rfb device tree blob";
			data = /incbin/("/home/dzq/share/eap2/PLATFORM/build/../linux/kernels/linux-5.4.203/arch/arm64/boot/dts/mediatek/mt7981-EAP650-Wall_2_0_0.dtb");
			type = "flat_dt";
			arch = "arm64";
			compression = "none";
			hash@1 {
				algo = "crc32";
			};
			hash@2 {
				algo = "sha1";
			};
		};

		fdt@EAP653_UR_1_0_0 {
			description = "ARM64 OpenWrt mt7981-spim-nand-rfb device tree blob";
			data = /incbin/("/home/dzq/share/eap2/PLATFORM/build/../linux/kernels/linux-5.4.203/arch/arm64/boot/dts/mediatek/mt7981-EAP653_UR_1_0_0.dtb");
			type = "flat_dt";
			arch = "arm64";
			compression = "none";
			hash@1 {
				algo = "crc32";
			};
			hash@2 {
				algo = "sha1";
			};
		};

		fdt@EAP653_UR_2_0_0 {
			description = "ARM64 OpenWrt mt7981-spim-nand-rfb device tree blob";
			data = /incbin/("/home/dzq/share/eap2/PLATFORM/build/../linux/kernels/linux-5.4.203/arch/arm64/boot/dts/mediatek/mt7981-EAP653_UR_2_0_0.dtb");
			type = "flat_dt";
			arch = "arm64";
			compression = "none";
			hash@1 {
				algo = "crc32";
			};
			hash@2 {
				algo = "sha1";
			};
		};

		fdt@EAP653_2_0_0 {
			description = "ARM64 OpenWrt mt7981-spim-nand-rfb device tree blob";
			data = /incbin/("/home/dzq/share/eap2/PLATFORM/build/../linux/kernels/linux-5.4.203/arch/arm64/boot/dts/mediatek/mt7981-EAP653_2_0_0.dtb");
			type = "flat_dt";
			arch = "arm64";
			compression = "none";
			hash@1 {
				algo = "crc32";
			};
			hash@2 {
				algo = "sha1";
			};
		};

		fdt@EAP650_2_0_0 {
			description = "ARM64 OpenWrt mt7981-spim-nand-rfb device tree blob";
			data = /incbin/("/home/dzq/share/eap2/PLATFORM/build/../linux/kernels/linux-5.4.203/arch/arm64/boot/dts/mediatek/mt7981-EAP650_2_0_0.dtb");
			type = "flat_dt";
			arch = "arm64";
			compression = "none";
			hash@1 {
				algo = "crc32";
			};
			hash@2 {
				algo = "sha1";
			};
		};


	};

	configurations {
		default = "config@EAP650_2_0_0";

		config@EAP650_3_0_0 {
			description = "OpenWrt";
			kernel = "kernel@1";
			fdt = "fdt@EAP650_3_0_0";
		};

		config@EAP653_3_0_0 {
			description = "OpenWrt";
			kernel = "kernel@1";
			fdt = "fdt@EAP653_3_0_0";
		};

		config@EAP655-WE_1_0_0 {
			description = "OpenWrt";
			kernel = "kernel@1";
			fdt = "fdt@EAP655-WE_1_0_0";
		};

		config@EAP655-WE-AC_1_0_0 {
			description = "OpenWrt";
			kernel = "kernel@1";
			fdt = "fdt@EAP655-WE-AC_1_0_0";
		};

		config@EAP650-Wall_2_0_0 {
			description = "OpenWrt";
			kernel = "kernel@1";
			fdt = "fdt@EAP650-Wall_2_0_0";
		};

		config@EAP653_UR_1_0_0 {
			description = "OpenWrt";
			kernel = "kernel@1";
			fdt = "fdt@EAP653_UR_1_0_0";
		};

		config@EAP653_UR_2_0_0 {
			description = "OpenWrt";
			kernel = "kernel@1";
			fdt = "fdt@EAP653_UR_2_0_0";
		};

		config@EAP653_2_0_0 {
			description = "OpenWrt";
			kernel = "kernel@1";
			fdt = "fdt@EAP653_2_0_0";
		};

		config@EAP650_2_0_0 {
			description = "OpenWrt";
			kernel = "kernel@1";
			fdt = "fdt@EAP650_2_0_0";
		};

	};
};
```
